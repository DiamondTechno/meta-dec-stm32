## conf/layer.conf
```bitbake
# meta-dec-stm32 layer config
# Diamond Technologies machine layer for STM32MP25-based DEC kits.

BBPATH .= ":${LAYERDIR}"

BBFILES += "${LAYERDIR}/recipes-*/*/*.bb \
            ${LAYERDIR}/recipes-*/*/*.bbappend"

BBFILE_COLLECTIONS += "meta-dec-stm32"
BBFILE_PATTERN_meta-dec-stm32 := "^${LAYERDIR}/"
BBFILE_PRIORITY_meta-dec-stm32 := "8"

EULA_FILE_ST:stm32mpcommonmx = "${LAYERDIR}/conf/eula/${MACHINE}"
EULA_FILE_ST_MD5SUM:stm32mpcommonmx = "8b505090fb679839cefbcc784afe8ce9"

LAYERVERSION_meta-dec-stm32 = "1"
LAYERSERIES_COMPAT_meta-dec-stm32 = "scarthgap styhead walnascar"

# meta-dec-stm32 stands on the ST upstream BSP plus meta-openembedded helpers.
# It deliberately does NOT depend on meta-st-cargt or meta-cargt-stm32mp-addons.
LAYERDEPENDS_meta-dec-stm32 = "stm-st-stm32mp"
LAYERDEPENDS_meta-dec-stm32 += "openembedded-layer meta-python"

# OpenSTLinux compatibility version (matches what meta-st-stm32mp publishes)
ST_OSTL_COMPATIBILITY_VERSION_meta-dec-stm32 = "6.1"
```

## conf/machine/stm32mp25-dec-kit.conf
```bitbake
#@TYPE: Machine
#@NAME: stm32mp25-dec-kit
#@DESCRIPTION: Configuration for the Diamond Technologies STM32MP257F DEC Kit
#@NEEDED_BSPLAYERS: layers/meta-openembedded/meta-oe layers/meta-openembedded/meta-python ../meta-dec-stm32 ../meta-dec-common

###########################################################################
#
# Default machine configuration sections
#
###########################################################################

# Common machine override hierarchy used by ST recipes
MACHINEOVERRIDES =. "stm32mpcommonmx:stm32mp2commonmx:stm32mp25commonmx:"
MACHINEOVERRIDES =. "stm32mp2common:stm32mp25common:"

include conf/machine/include/st-machine-common-stm32mp.inc
include conf/machine/include/st-machine-providers-stm32mp.inc

# =========================================================================
# Chip architecture
# =========================================================================
DEFAULTTUNE = "cortexa35"
include conf/machine/include/arm/armv8a/tune-cortexa35.inc

# =========================================================================
# Boot scheme
# =========================================================================
BOOTSCHEME_LABELS ?= "optee"
BOOTSCHEME_LABELS += "optee"
BOOTSCHEME_LABELS += "opteemin"
BOOTSCHEME_LABELS += "fastboot"
BOOTSCHEME_LABELS += "fastboot-opteemin"

# =========================================================================
# Boot devices supported on the carrier
# =========================================================================
BOOTDEVICE_LABELS ?= ""
BOOTDEVICE_LABELS += "sdcard"
BOOTDEVICE_LABELS += "emmc"

# =========================================================================
# Device tree wiring
#
# DEC_EXTDT_DTB is the project DTB name (CA35/.../{tf-a,u-boot,optee-os}/<NAME>.dts).
# DEC_EXTDT_PROJECT is the project tree directory shipped in this layer.
# =========================================================================
DEC_EXTDT_DTB = "stm32mp-dec-kit"
DEC_EXTDT_PROJECT = "dec-stm32mp25-kit"
DEC_EXTDT_PROJECT_NAME = "dec-stm32mp25-kit"
ENABLE_DEC_EXTDT ?= "1"

STM32MP_DT_FILES_NAND      += "${DEC_EXTDT_DTB}"
STM32MP_DT_FILES_NOR_all   += "${DEC_EXTDT_DTB}"
STM32MP_DT_FILES_NOR_mb    += "${DEC_EXTDT_DTB}"
STM32MP_DT_FILES_NOR_mb_sb += "${DEC_EXTDT_DTB}"
STM32MP_DT_FILES_EMMC      += "${DEC_EXTDT_DTB}"
STM32MP_DT_FILES_SDCARD    += "${DEC_EXTDT_DTB}"
STM32MP_DT_FILES_SPINAND   += "${DEC_EXTDT_DTB}"

# =========================================================================
# Machine features
# =========================================================================
MACHINE_FEATURES += "watchdog"
MACHINE_FEATURES += "${@'gpu' if d.getVar('ACCEPT_EULA_'+d.getVar('MACHINE')) == '1' else ''}"
MACHINE_FEATURES += "nxpwifi-nxpiw610-sdio"

# =========================================================================
# fip
# =========================================================================
FIP_BL31_ENABLE = "1"

# =========================================================================
# Flashlayout
# =========================================================================
FLASHLAYOUT_TYPE_LABELS:extensible = "${DEC_EXTDT_DTB}"

# =========================================================================
# u-boot per-config DTB selection
#
# The upstream u-boot-stm32mp-config.inc filters STM32MP_DEVICETREE per
# config by grepping for the SoC family substring (e.g. "stm32mp25").
# Our DEC kit DTB name (stm32mp-dec-kit) does NOT contain "stm32mp25",
# so the auto-filter returns empty → no per-DTB binaries get renamed →
# fip-stm32mp can't find them. Override directly to bypass the filter.
# =========================================================================
UBOOT_DEVICETREE[default_stm32mp25]         = "${STM32MP_DEVICETREE}"
UBOOT_DEVICETREE[programmer_stm32mp25]      = "${STM32MP_DEVICETREE_PROGRAMMER}"
UBOOT_DEVICETREE[fastboot-sdcard_stm32mp25] = "${STM32MP_DT_FILES_SDCARD}"
UBOOT_DEVICETREE[fastboot-emmc_stm32mp25]   = "${STM32MP_DT_FILES_EMMC}"

# =========================================================================
# OP-TEE per-flavor DTB selection
#
# optee-os-stm32mp-config.inc filters STM32MP_DEVICETREE by the same
# 'stm32mp25' substring. Bypass the same way: append our DTB directly so
# both 'optee' and 'opteemin' flavors get built for the DEC kit.
# =========================================================================
OPTEE_DEVICETREE_optee:append    = " ${STM32MP_DEVICETREE}"
OPTEE_DEVICETREE_opteemin:append = " ${STM32MP_DEVICETREE}"

# =========================================================================
# Add a synthetic SoC-name token that matches our DTB filename.
#
# fip-stm32mp's do_deploy iterates STM32MP_SOC_NAME and sets soc_suffix
# to whichever entry is a substring of the DTB filename. With the
# upstream-default STM32MP_SOC_NAME of just "stm32mp25", our DTB name
# (stm32mp-dec-kit) has no match → soc_suffix stays empty → the recipe
# emits `--search-soc-name --output ...` to create_st_fip_binary.sh,
# whose argv parser greedily consumes `--output` as the value of
# `--search-soc-name`. End result: --output is silently dropped, fiptool
# writes FIPs into recipe-sysroot/fip instead of DEPLOYDIR/fip, and
# nothing ends up in tmp-glibc/deploy/images/.../fip.
#
# Append "dec-kit" so the substring match succeeds and a non-empty
# soc_suffix gets passed to the script.
# =========================================================================
STM32MP_SOC_NAME:append = " dec-kit"

# =========================================================================
# Quiet boot: turn off the upstream ST verbose-trace preset for TF-A,
# OP-TEE, and U-Boot in one shot. Each component picks this up via its
# ST_*_DEBUG_TRACE override (defaulted from ST_DEBUG_TRACE). Effect:
#   - TF-A: built without DEBUG=1, LOG_LEVEL=20 (NOTICE) instead of 40 (INFO)
#   - OP-TEE: CFG_TEE_*_LOG_LEVEL stays low
#   - U-Boot: 0098-silent_mode.patch + fragment-01-silent_mode.cfg applied
# Re-enable per-component by setting ST_TF_A_DEBUG_TRACE / ST_OPTEE_DEBUG_TRACE /
# ST_UBOOT_DEBUG_TRACE to "1" individually if you need debug output.
# =========================================================================
# DIAGNOSTIC: temporarily set ST_DEBUG_TRACE = "1" to build TF-A with
# DEBUG=1 (matching cargt's working build) and OP-TEE with verbose
# logging. We're investigating whether release-mode TF-A has an SDMMC
# init regression on the DEC kit. Revert to "0" once eMMC boot is
# confirmed working in release mode.
ST_DEBUG_TRACE = "1"
ST_UBOOT_DEBUG_TRACE = "1"
# Don't squelch the kernel either. ST_DEBUG_TRACE=0 normally appends
# "loglevel=1 quiet" to the kernel cmdline via ST_CMD_LINE_DEBUG_TRACE;
# blank it out so the kernel prints normally.
ST_CMD_LINE_DEBUG_TRACE = ""

# Append a literal "${optargs}" placeholder to the extlinux APPEND line.
# u-boot's sysboot calls cli_simple_process_macros() on the APPEND
# string before storing it in $bootargs (boot/pxe_utils.c:310), which
# substitutes ${name}-style references from the env. So users can do:
#   => setenv optargs "ip=dhcp loglevel=7 my_param=foo"
#   => saveenv
#   => reset
# and the next boot's kernel command line will include those args.
# When optargs is unset, the substitution yields an empty string —
# safe.
UBOOT_EXTLINUX_KERNEL_ARGS:append = " \${optargs}"

# =========================================================================
# WLAN/Bluetooth — the IW610 lives on the SOM and any image for this
# kit needs the moal driver and matching combined firmware. Pull them
# in at the machine level so core-image-weston (and any other image
# you bitbake) gets them automatically without touching its recipe.
# =========================================================================
IMAGE_INSTALL:append = " \
    kernel-module-nxp-wlan \
    nxp-wlan-firmware-nxp-common \
    nxp-wlan-firmware-nxpiw610-sdio \
"

# =========================================================================
# Kernel DTBs to deploy
#
# The base stm32mp-dec-kit.dtb is already added by the upstream ST
# chain (STM32MP_DT_FILES_SDCARD → STM32MP_DEVICETREE →
# STM32MP_KERNEL_DEVICETREE → KERNEL_DEVICETREE). We only need to
# append the panel-variant DTBs so users can switch displays via
# u-boot's fdtfile env var.
# =========================================================================
KERNEL_DEVICETREE:append = " \
    st/stm32mp-dec-kit-5.5.dtb \
    st/stm32mp-dec-kit-7.0.dtb \
    st/stm32mp-dec-kit-10.1.dtb \
"

# =========================================================================
# M33 Co-processor (kept off by default; enable with ACCEPT_EULA + features)
# =========================================================================
CUBEMX_M33_TZ ?= "0"
M33PROJECT_TF_M_TRUSTZONE = "${@bb.utils.contains('MACHINE_FEATURES', 'm33td', '0', '${CUBEMX_M33_TZ}', d)}"

# =========================================================================
# Distro feature lift — DEC products want systemd + NetworkManager even
# when the upstream openstlinux-weston distro is used unmodified.
# =========================================================================
DISTRO_FEATURES:append = " systemd networkmanager"
NETWORK_MANAGER = "networkmanager"
RDEPENDS:packagegroup-core-tools-testapps:remove = "connman-tools connman-tests connman-client"

# Init manager — ensure systemd is the active provider
DISTRO_FEATURES_BACKFILL_CONSIDERED:append = " sysvinit"
VIRTUAL-RUNTIME_init_manager = "systemd"
VIRTUAL-RUNTIME_initscripts = ""

# meta-dec-common's layer.conf installs dec-eeprom-{decoder,services} for
# every DEC machine. Those scripts target the imx93 EEPROM scheme and the
# decoder's upstream repo isn't published — so strip them on this board.
IMAGE_INSTALL:remove = "dec-eeprom-decoder dec-eeprom-services"
```
